## config/boards/shields/occultist/Kconfig.defconfig
```kconfig
# Copyright (c) 2020 The ZMK Contributors
# SPDX-License-Identifier: MIT

config ZMK_BLE
	default y

config ZMK_USB
	default y

if SHIELD_OCCULTIST_NORM_LEFT || SHIELD_OCCULTIST_NORM_RIGHT

config ZMK_KEYBOARD_NAME
	default "The Occultist"

endif

if SHIELD_OCCULTIST_NORM_RIGHT

config ZMK_SPLIT
	default y

endif



if SHIELD_OCCULTIST_NORM_LEFT

config ZMK_SPLIT
	default y

config ZMK_SPLIT_BLE_ROLE_CENTRAL
	default y

endif
```

## config/boards/shields/occultist/Kconfig.shield
```kconfig
# Copyright (c) 2020 The ZMK Contributors
# SPDX-License-Identifier: MIT

config SHIELD_OCCULTIST_NORM_LEFT
	def_bool $(shields_list_contains,occultist_norm_left)

config SHIELD_OCCULTSIT_NORM_RIGHT
	def_bool $(shields_list_contains,occultist_norm_right)
```
